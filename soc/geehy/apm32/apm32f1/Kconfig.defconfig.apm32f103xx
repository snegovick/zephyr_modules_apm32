## soc/geehy/apm32/apm32f1/Kconfig.defconfig.apm32f103xx
```kconfig
# Copyright (c) 2023, Quincy.W <wangqyfm@foxmail.com>
# SPDX-License-Identifier: Apache-2.0

if SOC_APM32F103X4 || SOC_APM32F103X6 || SOC_APM32F103X8 || SOC_APM32F103XB

config SOC
	default "apm32f103xb"

config NUM_IRQS
	default 43

endif # SOC_APM32F103X4 || SOC_APM32F103X6 || SOC_APM32F103X8 || SOC_APM32F103XB

if SOC_APM32F103XC || SOC_APM32F103XD || SOC_APM32F103XE

config SOC
	default "apm32f103xe"

config NUM_IRQS
	default 65

endif # SOC_APM32F103XC || SOC_APM32F103XD || SOC_APM32F103XE
```

## soc/geehy/apm32/apm32f1/Kconfig.defconfig.series
```kconfig
# Copyright (c) 2023, Quincy.W <wangqyfm@foxmail.com>
# SPDX-License-Identifier: Apache-2.0

if SOC_SERIES_APM32F1X

config APM32F10X_LD
	bool

config APM32F10X_MD
	bool

config APM32F10X_HD
	bool

config APM32F10X_CL
	bool

rsource "Kconfig.defconfig.apm32f1*"

config SOC_SERIES
	default "apm32f1"

endif # SOC_SERIES_APM32F1X
```

## soc/geehy/apm32/apm32f1/Kconfig.soc
```kconfig
# Copyright (c) 2023, Quincy.W <wangqyfm@foxmail.com>
# Copyright (c) 2025, Excave.ru
# SPDX-License-Identifier: Apache-2.0

config SOC_SERIES_APM32F1X
	bool "APM32F1x Series MCU"
	select ARM
	select CPU_CORTEX_M3
	select CPU_CORTEX_M_HAS_DWT
	select SOC_FAMILY_APM32
	help
	  Enable support for APM32F1 MCU series

config SOC_SERIES
	default "apm32f1x" if SOC_SERIES_APM32F1X

choice
	prompt "APM32F1x MCU Selection"
	depends on SOC_SERIES_APM32F1X

config SOC_APM32F103X4
	# 16KB Flash, 6KB SRAM
	bool "APM32F103X4"
	select APM32F10X_LD

config SOC_APM32F103X6
	# 32KB Flash, 10KB SRAM
	bool "APM32F103X6"
	select APM32F10X_LD

config SOC_APM32F103X8
	# 64KB Flash, 20KB SRAM
	bool "APM32F103X8"
	select APM32F10X_MD

config SOC_APM32F103XB
	# 128KB Flash, 20KB SRAM
	bool "APM32F103XB"
	select APM32F10X_MD

config SOC_APM32F103XC
	# 256KB Flash, 64KB SRAM
	bool "APM32F103XC"
	select APM32F10X_HD

config SOC_APM32F103XD
	# 384KB Flash, 64KB SRAM
	bool "APM32F103XD"
	select APM32F10X_HD

config SOC_APM32F103XE
	# 512KB Flash, 128KB SRAM
	bool "APM32F103XE"
	select APM32F10X_HD

endchoice
```

## soc/geehy/apm32/apm32f4/Kconfig.defconfig.apm32f405xx
```kconfig
# Copyright (c) 2023, Quincy.W <wangqyfm@foxmail.com>
# SPDX-License-Identifier: Apache-2.0

if SOC_APM32F405XG

config SOC
	default "apm32f405xx"

config NUM_IRQS
	default 85

endif # SOC_APM32F405XG
```

## soc/geehy/apm32/apm32f4/Kconfig.defconfig.apm32f411xx
```kconfig
# Copyright (c) 2023, Quincy.W <wangqyfm@foxmail.com>
# SPDX-License-Identifier: Apache-2.0

if SOC_APM32F411XC || SOC_APM32F411XE

config SOC
	default "apm32f411xx"

config NUM_IRQS
	default 75

endif # SOC_APM32F411XC || SOC_APM32F411XE
```

## soc/geehy/apm32/apm32f4/Kconfig.defconfig.apm32f417xx
```kconfig
# Copyright (c) 2023, Quincy.W <wangqyfm@foxmail.com>
# SPDX-License-Identifier: Apache-2.0

if SOC_APM32F417XG

config SOC
	default "apm32f417xx"

config NUM_IRQS
	default 82

endif # SOC_APM32F417XG
```

## soc/geehy/apm32/apm32f4/Kconfig.defconfig.series
```kconfig
# Copyright (c) 2023, Quincy.W <wangqyfm@foxmail.com>
# SPDX-License-Identifier: Apache-2.0

if SOC_SERIES_APM32F4X

#config APM32F10X_LD
#	bool
#
#config APM32F10X_MD
#	bool
#
#config APM32F10X_HD
#	bool
#
#config APM32F10X_CL
#	bool

rsource "Kconfig.defconfig.apm32f4*"

config SOC_SERIES
	default "apm32f4"

endif # SOC_SERIES_APM32F4X
```

## soc/geehy/apm32/apm32f4/Kconfig.series
```kconfig
# Copyright (c) 2023, Quincy.W <wangqyfm@foxmail.com>
# Copyright (c) 2025, Excave.ru
# SPDX-License-Identifier: Apache-2.0

config SOC_SERIES_APM32F4X
	bool "APM32F4x Series MCU"
	select ARM
	select CPU_CORTEX_M4
	select CPU_CORTEX_M_HAS_DWT
	select CPU_HAS_FPU
	select SOC_FAMILY_APM32
	select CPU_HAS_ARM_MPU
	select HAS_SWO
	help
	  Enable support for APM32F4 MCU series
```

## soc/geehy/apm32/apm32f4/Kconfig.soc
```kconfig
# Copyright (c) 2023, Quincy.W <wangqyfm@foxmail.com>
# Copyright (c) 2025, Excave.ru
# SPDX-License-Identifier: Apache-2.0

config SOC_SERIES_APM32F4X
	bool "APM32F4x Series MCU"
	select ARM
	select CPU_CORTEX_M4
	select CPU_CORTEX_M_HAS_DWT
	select CPU_HAS_FPU
	select SOC_FAMILY_APM32
	select CPU_HAS_ARM_MPU
	select HAS_SWO
	help
	  Enable support for APM32F4 MCU series

config SOC_SERIES
	default "apm32f4x" if SOC_SERIES_APM32F4X

choice
	prompt "APM32F4x MCU Selection"
	depends on SOC_SERIES_APM32F4X

config SOC_APM32F405XG
	# 1024KB Flash, 194+4KB SRAM
	bool "APM32F405XG"

config SOC_APM32F407XE
	# 512KB Flash, 194+4KB SRAM
	bool "APM32F407XE"

config SOC_APM32F407XG
	# 1024KB Flash, 194+4KB SRAM
	bool "APM32F407XG"

config SOC_APM32F411XC
	# 256KB Flash, 128KB SRAM
	bool "APM32F411XC"
	
config SOC_APM32F411XE
	# 512KB Flash, 128KB SRAM
	bool "APM32F411XE"

config SOC_APM32F417XG
	# 1024KB Flash, 194+4KB SRAM
	bool "APM32F417XG"

endchoice
```
