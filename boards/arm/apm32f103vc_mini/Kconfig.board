## boards/arm/apm32f103vc_mini/Kconfig.board
```kconfig
# apm32f103vc_mini
# Copyright (c) 2023, Quincy.W <wangqyfm@foxmail.com>
# SPDX-License-Identifier: Apache-2.0

config BOARD_APM32F103VC_MINI
    bool "APM32F103VC Mini Board"
    #depends on SOC_APM32F103XE
```

## boards/arm/apm32f103vc_mini/Kconfig.defconfig
```kconfig
# apm32f103vc_mini
# Copyright (c) 2023, Quincy.W <wangqyfm@foxmail.com>
# SPDX-License-Identifier: Apache-2.0

if BOARD_APM32F103VC_MINI

config BOARD
	default "apm32f103vc_mini"

endif # BOARD_APM32F103VC_MINI
```

## boards/arm/apm32f103vc_mini/apm32f103vc_mini_defconfig
```kconfig
# apm32f103vc_mini
# Copyright (c) 2023, Quincy.W <wangqyfm@foxmail.com>
# SPDX-License-Identifier: Apache-2.0

CONFIG_SOC_SERIES_APM32F1X=y
CONFIG_SOC_APM32F103XE=y

CONFIG_CLOCK_CONTROL=y
CONFIG_CLOCK_CTRL_APM32=y
CONFIG_SYS_CLOCK_HW_CYCLES_PER_SEC=8000000

CONFIG_GPIO=y

CONFIG_DEBUG_OPTIMIZATIONS=y
```

## boards/arm/apm32f411vc_mini/Kconfig.board
```kconfig
# apm32f411vc_mini
# Copyright (c) 2023, Quincy.W <wangqyfm@foxmail.com>
# SPDX-License-Identifier: Apache-2.0

config BOARD_APM32F411VC_MINI
    bool "APM32F411VC Mini Board"
```

## boards/arm/apm32f411vc_mini/Kconfig.defconfig
```kconfig
# apm32f411vc_mini
# Copyright (c) 2023, Quincy.W <wangqyfm@foxmail.com>
# SPDX-License-Identifier: Apache-2.0

if BOARD_APM32F411VC_MINI

config BOARD
	default "apm32f411vc_mini"

endif # BOARD_APM32F411VC_MINI
```

## boards/arm/apm32f411vc_mini/apm32f411vc_mini_defconfig
```kconfig
# apm32f411vc_mini
# Copyright (c) 2023, Quincy.W <wangqyfm@foxmail.com>
# SPDX-License-Identifier: Apache-2.0

CONFIG_SOC_SERIES_APM32F4X=y
CONFIG_SOC_APM32F411XE=y

CONFIG_CLOCK_CONTROL=y
CONFIG_CLOCK_CTRL_APM32=y
CONFIG_SYS_CLOCK_HW_CYCLES_PER_SEC=168000000

CONFIG_GPIO=y

CONFIG_DEBUG_OPTIMIZATIONS=y
```

## drivers/clock_control/Kconfig.apm32
```kconfig
# Copyright (c) 2023, Quincy.W <wangqyfm@foxmail.com>
# SPDX-License-Identifier: Apache-2.0

menuconfig CLOCK_CTRL_APM32
	bool "CLOCK_CTRL Driver for APM32 family of MCUs"
	default y
	depends on SOC_FAMILY_APM32
	help
	  Enable CLOCK_CTRL driver for APM32 MCUs

if CLOCK_CTRL_APM32
	
endif # CLOCK_CTRL_APM32
```

## drivers/flash/Kconfig
```kconfig
# Copyright (c) 2023, Quincy.W <wangqyfm@foxmail.com>
# SPDX-License-Identifier: Apache-2.0

if FLASH

module = FLASH
module-str = flash
source "subsys/logging/Kconfig.template.log_config"

rsource "./Kconfig.*"

endif # FLASH
```

## drivers/flash/Kconfig.apm32
```kconfig
# Copyright (c) 2023, Quincy.W <wangqyfm@foxmail.com>
# SPDX-License-Identifier: Apache-2.0

config SOC_FLASH_APM32
	bool "APM32 flash driver"
	default y
	depends on FLASH
	select FLASH_HAS_PAGE_LAYOUT
	select FLASH_HAS_DRIVER_ENABLED
	select APM32_HAL_FMC
	help
	  Enables APM32 driver.
```

## drivers/gpio/Kconfig.apm32
```kconfig
# Copyright (c) 2023, Quincy.W <wangqyfm@foxmail.com>
# SPDX-License-Identifier: Apache-2.0

menuconfig GPIO_APM32
	bool "GPIO Driver for APM32 family of MCUs"
    default y
	depends on SOC_FAMILY_APM32
	select APM32_HAL_GPIO
	help
	  Enable GPIO driver for APM32 MCUs

if GPIO_APM32

choice GPIO_APM32_SWJ
	prompt "Serial wire JTAG configuration"
	depends on SOC_SERIES_APM32F1X

config GPIO_APM32_SWJ_ENABLE
	bool "Full SWJ (JTAG-DP + SW-DP): Reset State"

config GPIO_APM32_SWJ_NONJTRST
	bool "Full SWJ (JTAG-DP + SW-DP) but without NJTRST"

config GPIO_APM32_SWJ_NOJTAG
	bool "JTAG-DP Disabled and SW-DP Enabled"

config GPIO_APM32_SWJ_DISABLE
	bool "JTAG-DP Disabled and SW-DP Disabled"

endchoice

endif # GPIO_APM32
```

## drivers/i2c/Kconfig.apm32
```kconfig
# Copyright (c) 2023, Quincy.W <wangqyfm@foxmail.com>
# SPDX-License-Identifier: Apache-2.0

menuconfig I2C_APM32
	bool "I2C Driver for APM32 family of MCUs"
	depends on SOC_FAMILY_APM32
	select APM32_HAL_I2C
	help
	  Enable I2C driver for APM32 MCUs

if I2C_APM32

endif # I2C_APM32
```

## drivers/pinctrl/Kconfig.apm32
```kconfig
# Copyright (c) 2023, Quincy.W <wangqyfm@foxmail.com>
# SPDX-License-Identifier: Apache-2.0

config PINCTRL_APM32
	bool "PINCTRL Driver for APM32 family of MCUs"
    default y
	depends on PINCTRL
	depends on SOC_FAMILY_APM32
```

## drivers/serial/Kconfig.apm32
```kconfig
# Copyright (c) 2023, Quincy.W <wangqyfm@foxmail.com>
# SPDX-License-Identifier: Apache-2.0

config UART_APM32
	bool "APM32 MCU serial driver"
	default y
	depends on SERIAL
	depends on SOC_FAMILY_APM32
	select SERIAL_HAS_DRIVER
	select APM32_HAL_USART
	# select SERIAL_SUPPORT_INTERRUPT
	help
	  This option enables the UART driver for APM32 family of processors.
```

## drivers/spi/Kconfig.apm32
```kconfig
# Copyright (c) 2023, Quincy.W <wangqyfm@foxmail.com>
# SPDX-License-Identifier: Apache-2.0

menuconfig SPI_APM32
	bool "SPI Driver for APM32 family of MCUs"
	select USE_NS_STD_LIB_SPI
	depends on SOC_FAMILY_APM32
	help
	  Enable SPI driver for APM32 MCUs
```

## dts/bindings/clock/geehy,apm32-hse-clock.yaml
```yaml
# Copyright (c) 2023, Quincy.W <wangqyfm@foxmail.com>
# SPDX-License-Identifier: Apache-2.0

description: APM32 HSE Clock

compatible: "geehy,apm32-hse-clock"

include: [fixed-clock.yaml]

properties:
  hse-bypass:
    type: boolean
    description: HSE crystal oscillator bypass
```

## dts/bindings/clock/geehy,apm32f4-pll-clock.yaml
```yaml
# Copyright (c) 2023, Quincy.W <wangqyfm@foxmail.com>
# SPDX-License-Identifier: Apache-2.0

description: |
    APM32F4 PLL, the frequency can be computed with the following formula:

    f(VCO clock) = f(PLL1 clock input) × ( PLL1A / PLLB )
    f(PLL1 clock output) = f(VCO clock) / PLL1C
    f(OTG_FS, SDIO, RNG clock output) = f(VCO clock) / PLLD

compatible: "geehy,apm32f4-pll-clock"

include: [clock-controller.yaml, base.yaml]

properties:
  "#clock-cells":
    const: 0

  clocks:
    required: true

  div-b:
    type: int
    required: true
    description: |
        Division factor for the PLL input clock
        Valid range: 2 - 63

  mul-a:
    type: int
    required: true
    description: |
        Main PLL multiplication factor for VCO
        Valid range: 50 - 432

  div-c:
    type: int
    required: true
    description: |
        Main PLL division factor for PLL output
    enum:
      - 2
      - 4
      - 6
      - 8

  div-d:
    type: int
    description: |
        Main PLL division factor for USB OTG FS, SDIO and RNG clocks.
        Valid range: 2 - 15
```

## dts/bindings/gpio/geehy,apm32-gpio.yaml
```yaml
# Copyright (c) 2023, Quincy.W <wangqyfm@foxmail.com>
# SPDX-License-Identifier: Apache-2.0

description: Geehy APM32 family GPIO node

compatible: "geehy,apm32-gpio"

include: [gpio-controller.yaml, base.yaml]

properties:
    reg:
      required: true

    clocks:
      required: true

    "#gpio-cells":
      const: 2

gpio-cells:
  - pin
  - flags
```

## hal/Kconfig
```kconfig
# Copyright (c) 2023, Quincy.W <wangqyfm@foxmail.com>
# SPDX-License-Identifier: Apache-2.0

config APM32_HAL_LIBRARY
	bool
	depends on SOC_FAMILY_APM32

if APM32_HAL_LIBRARY

config APM32_HAL_ADC
    bool 

config APM32_HAL_BAKPR
    bool 

config APM32_HAL_CAN
    bool 

config APM32_HAL_CRC
    bool 

config APM32_HAL_DAC
    bool 

config APM32_HAL_DBGMCU
    bool 

config APM32_HAL_DMA
    bool 

config APM32_HAL_DMC
    bool 

config APM32_HAL_EINT
    bool 

config APM32_HAL_FMC
    bool 

config APM32_HAL_GPIO
    bool 

config APM32_HAL_I2C
    bool 

config APM32_HAL_IWDT
    bool 

# config APM32_HAL_MISC
#     bool 

config APM32_HAL_PMU
    bool 

config APM32_HAL_QSPI
    bool 

config APM32_HAL_RTC
    bool 

config APM32_HAL_SCI2C
    bool 

config APM32_HAL_SDIO
    bool 

config APM32_HAL_SMC
    bool 

config APM32_HAL_SPI
    bool 

config APM32_HAL_TMR
    bool 

config APM32_HAL_USART
    bool 

config APM32_HAL_WWDT
    bool 

endif # APM32_HAL_LIBRARY
```

## soc/arm/geehy_apm32/Kconfig
```kconfig
# Copyright (c) 2023, Quincy.W <wangqyfm@foxmail.com>
# SPDX-License-Identifier: Apache-2.0

config SOC_FAMILY_APM32
	bool
	select BUILD_OUTPUT_HEX
	select APM32_HAL_LIBRARY

if SOC_FAMILY_APM32

config SOC_FAMILY
	string
	default "geehy_apm32"

rsource "./*/Kconfig.soc"

endif # SOC_FAMILY_APM32
```

## soc/arm/geehy_apm32/apm32f1/Kconfig.series
```kconfig
# Copyright (c) 2023, Quincy.W <wangqyfm@foxmail.com>
# SPDX-License-Identifier: Apache-2.0

config SOC_SERIES_APM32F1X
	bool "APM32F1x Series MCU"
	select ARM
	select CPU_CORTEX_M3
	select CPU_CORTEX_M_HAS_DWT
	select SOC_FAMILY_APM32
	help
	  Enable support for APM32F1 MCU series
```

## soc/arm/geehy_apm32/apm32f1/Kconfig.soc
```kconfig
# Copyright (c) 2023, Quincy.W <wangqyfm@foxmail.com>
# SPDX-License-Identifier: Apache-2.0

choice
	prompt "APM32F1x MCU Selection"
	depends on SOC_SERIES_APM32F1X

config SOC_APM32F103X4
	# 16KB Flash, 6KB SRAM
	bool "APM32F103X4"
	select APM32F10X_LD

config SOC_APM32F103X6
	# 32KB Flash, 10KB SRAM
	bool "APM32F103X6"
	select APM32F10X_LD

config SOC_APM32F103X8
	# 64KB Flash, 20KB SRAM
	bool "APM32F103X8"
	select APM32F10X_MD

config SOC_APM32F103XB
	# 128KB Flash, 20KB SRAM
	bool "APM32F103XB"
	select APM32F10X_MD

config SOC_APM32F103XC
	# 256KB Flash, 64KB SRAM
	bool "APM32F103XC"
	select APM32F10X_HD

config SOC_APM32F103XD
	# 384KB Flash, 64KB SRAM
	bool "APM32F103XD"
	select APM32F10X_HD

config SOC_APM32F103XE
	# 512KB Flash, 128KB SRAM
	bool "APM32F103XE"
	select APM32F10X_HD

endchoice
```

## soc/arm/geehy_apm32/apm32f4/Kconfig.defconfig.apm32f407xx
```kconfig
# Copyright (c) 2023, Quincy.W <wangqyfm@foxmail.com>
# SPDX-License-Identifier: Apache-2.0

if SOC_APM32F407XE || SOC_APM32F407XG

config SOC
	default "apm32f407xx"

config NUM_IRQS
	default 85

endif # SOC_APM32F407XE || SOC_APM32F407XG
```

## soc/arm/geehy_apm32/apm32f4/Kconfig.soc
```kconfig
# Copyright (c) 2023, Quincy.W <wangqyfm@foxmail.com>
# SPDX-License-Identifier: Apache-2.0

choice
	prompt "APM32F4x MCU Selection"
	depends on SOC_SERIES_APM32F4X

config SOC_APM32F405XG
	# 1024KB Flash, 194+4KB SRAM
	bool "APM32F405XG"

config SOC_APM32F407XE
	# 512KB Flash, 194+4KB SRAM
	bool "APM32F407XE"

config SOC_APM32F407XG
	# 1024KB Flash, 194+4KB SRAM
	bool "APM32F407XG"

config SOC_APM32F411XC
	# 256KB Flash, 128KB SRAM
	bool "APM32F411XC"
	
config SOC_APM32F411XE
	# 512KB Flash, 128KB SRAM
	bool "APM32F411XE"

config SOC_APM32F417XG
	# 1024KB Flash, 194+4KB SRAM
	bool "APM32F417XG"

endchoice
```

## soc/geehy/apm32/Kconfig
```kconfig
# Copyright (c) 2023, Quincy.W <wangqyfm@foxmail.com>
# Copyright (c) 2025, Excave.ru
# SPDX-License-Identifier: Apache-2.0

config SOC_FAMILY_APM32
	bool
	select BUILD_OUTPUT_HEX
	select APM32_HAL_LIBRARY

# if SOC_FAMILY_APM32

# rsource "*/Kconfig"

# endif # SOC_FAMILY_APM32
```

## soc/geehy/apm32/Kconfig.soc
```kconfig
# Copyright (c) 2023, Quincy.W <wangqyfm@foxmail.com>
# Copyright (c) 2025, Excave.ru
# SPDX-License-Identifier: Apache-2.0

config SOC_FAMILY_APM32
	bool

config SOC_FAMILY
	default "apm32" if SOC_FAMILY_APM32
  
rsource "*/Kconfig.soc"
```
